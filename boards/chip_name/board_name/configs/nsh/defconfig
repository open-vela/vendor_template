## chips/chip_name/Kconfig
```kconfig
#
# For a description of the syntax of this configuration file,
# see the file kconfig-language.txt in the NuttX tools repository.
#

if ARCH_CHIP_CUSTOM

comment "VENDOR_NAME Configuration Options"

choice
    prompt "VENDOR_NAME Chip Selection"
    default ARCH_CHIP_CHIP_NAME

config ARCH_CHIP_CHIP_NAME
	bool "chip_name"
	select ARCH_CORTEXM4
	select ARCH_HAVE_MPU
	select ARM_HAVE_MPU_UNIFIED
	select ARCH_HAVE_FPU

endchoice

endif
```
